## .west/west.yml
```yaml
# Copyright (c) 2021 Nordic Semiconductor ASA
# SPDX-License-Identifier: Apache-2.0

manifest:
  self:
    west-commands: west-commands.yml

  remotes:
    - name: jonathan-thomson
      url-base: https://github.com/jonathan-thomson
    - name: catchorg
      url-base: https://github.com/catchorg
    - name: meekrosoft
      url-base: https://github.com/meekrosoft

  projects:
    - name: zephyr
      remote: jonathan-thomson
      repo-path: zephyr.git
      revision: e72fd66378ccdef18ca864c7bc23a88604f695ed
      import:
        path-prefix: thirdparty/zephyrproject
        name-allowlist:
          - cmsis_6
          - hal_nxp
          - picolibc
          - segger
          - mbedtls
          
    - name: Catch2
      remote: catchorg
      revision: 644821ce28cb25d7992a4d0375b1d83214392592 # v3.9.1
      path: thirdparty/catch2

    - name: fff
      remote: meekrosoft
      revision: 7e09f07e5b262b1cc826189dc5057379e40ce886 # v1.1
      path: thirdparty/fff
```

## platform/dts/bindings/bosch,bmp581-i2c.yaml
```yaml
# Bosch BMP581 barometric pressure sensor
# Copyright (c) Fisher & Paykel Healthcare. All Rights Reserved.
# SPDX-License-Identifier: Apache-2.0 
 

description: |
    Bosch BMP581 barometric pressure sensor accessed through I2C bus

compatible: "bosch,bmp581-custom"

include: [i2c-device.yaml, "bosch,bmp581.yaml"]
```

## platform/dts/bindings/bosch,bmp581.yaml
```yaml
# Bosch BMP581 barometric pressure sensor
# Copyright (c) Fisher & Paykel Healthcare. All Rights Reserved.
# SPDX-License-Identifier: Apache-2.0 
 

include: sensor-device.yaml

properties:

  iir-filter:
    type: int
    description: |
      Default IIR filter coefficient. The default 0 is the chip reset value.
    default: 0
    enum:
      - 0
      - 1
      - 3
      - 7
      - 15
      - 31
      - 63
      - 127
```

## platform/dts/bindings/epson,rx8900ce.yaml
```yaml
# Copyright (c) 2025 Måns Ansgariusson <mansgariusson@gmail.com>
# SPDX-License-Identifier: Apache-2.0

description: RX8900CE RTC

compatible: "epson,rx8900ce"
include: [i2c-device.yaml, rtc-device.yaml]

properties:
  clockout-frequency:
    type: int
    description: |
      Specify the ociillator frequency in Hz, if not specified the clockout will be disabled.
      - 1 # 1 Hz oscillator
      - 1024 # 1 kHz oscillator
      - 32768 # 32 kHz oscillator
    enum: [1, 1024, 32768]
```

## platform/dts/bindings/nxp,imx-pwm-ext.yaml
```yaml
# Copyright (c) 2019, Linaro Limited
# SPDX-License-Identifier: Apache-2.0

description: NXP MCUX PWM with QTMR as external clock source

compatible: "nxp,imx-pwm-ext"

include: [pwm-controller.yaml, pinctrl-device.yaml, base.yaml]

properties:
  index:
    type: int
    description: flexpwm submodule index
    required: true

  interrupts:
    required: true

  run-in-wait:
    type: boolean
    description: |
      Enable for PWM to keep running in WAIT mode.

  run-in-debug:
    type: boolean
    description: |
      Enable for PWM to keep running in debug mode.

  nxp,prescaler:
    type: int
    enum: [1, 2, 4, 8, 16, 32, 64, 128]
    required: true
    description: |
      Clock prescaler at the input of the PWM.

  nxp,reload:
    type: string
    enum:
      - "immediate"
      - "half-cycle"
      - "full-cycle"
      - "half-and-full-cycle"
    description: |
      Select how to load the buffered-registers with new values:
      "immediate" - buffered-registers get loaded with new values as soon as LDOK bit is set;
      "half-cycle" - registers loaded on a PWM half cycle;
      "full-cycle" - registers loaded on a PWM full cycle;
      "half-and-full-cycle" - registers loaded on a PWM half & full cycle.

  qtmr:
    description: Phandle of QTMR
    type: phandle
    required: true

  qtmr-channel:
    description: Channel (timer group) index to use as PWM input
    type: int
    enum: [0, 1, 2, 3]
    required: true

  xbar-config:
    type: phandle
    description: xbar handle and its map which should have an entry that connects a qtmr output to pwm ext clk input
    required: true

  "#pwm-cells":
    const: 3

pwm-cells:
  - channel
  - period
  - flags
```

## platform/dts/bindings/ralf_motor.yaml
```yaml
description: |
    This binding provides resources required to use ralf motor

compatible: "ralf-motor"

include: [spi-device.yaml]
```

## platform/dts/bindings/sensirion,sdp3x.yaml
```yaml
# Sensirion SDP3X digital pressure sensor
# Copyright (c) Fisher & Paykel Healthcare. All Rights Reserved.

description:
  Sensirion SDP3X digital pressure sensor accessed through I2C bus

compatible: "sensirion,sdp3x"

include: [i2c-device.yaml]
```

## platform/dts/bindings/solomon,ssd1363-common-ext.yaml
```yaml
include: display-controller.yaml

properties:
  use-internal-iref:
    type: boolean
    description: |
      When external IREF is selected, the magnitude of IREF is controlled by
      the value of resistor, which is connected between IREF pin and VSS.
      When internal IREF is selected, the IREF pin should be kept NC.

  reset-period:
    type: int
    default: 4
    description: |
      Phase 1 period of driving an OLED pixel. Choose from 1-15 DCLK(s)

  precharge-period:
    type: int
    default: 7
    description: |
      Phase 2 period of driving an OLED pixel. Choose from 1-15 DCLK(s)

  front-clock-divider:
    type: int
    default: 0
    description: |
      Front clock divider. Ratio is from 1 to 16 with default ratio = 1
      DCLK = Fosc / *D*

  oscillator-frequency:
    type: int
    default: 6
    description: |
      Oscillator frequency. Frequency increases as level increases.
      DCLK = *Fosc* / D

  second-precharge-period:
    type: int
    default: 8
    description: Phase 3 period of driving an OLED pixel. Choose from 1-15 DCLK(s)

  precharge-voltage-config-ext-cap:
    type: boolean
    description: |
      External capacitance mode is enabled when Vp pin 
      is connected to an external capacitor to GND in application.
      Default when Vp pin is float in application

  precharge-voltage:
    type: int
    default: 7
    description: |
      Precharge voltage level. Choose from 0-31
        0: 0.10 x Vcc
        7: 0.193 x Vcc
        31: 0.5133 x Vcc
      Value MUST be smaller than Vcomh voltage

  vcomh-voltage:
    type: int
    default: 4
    description: |
      Precharge voltage level. Choose from 0-7
        0: 0.72 x Vcc
        4: 0.80 x Vcc
        7: 0.86 x Vcc
      Value MUST be smaller than precharge voltage

  reset-gpios:
    type: phandle-array
    description: RESET pin.

      The RESET pin of SSD1363 is active low.
      If connected directly the MCU pin should be configured
      as active low.

  ready-time-ms:
    type: int
    default: 100
    description: |
      Time it takes for the device from power up to become responsive and
      accepting commands. Defaults to 100ms if not provided.
```

## platform/dts/bindings/solomon,ssd1363-i2c.yaml
```yaml
description: SSD13363 320x160 OLED controller on I2C bus

compatible: "solomon,ssd1363-ext"

include: ["solomon,ssd1363-common-ext.yaml", "i2c-device.yaml"]
```

## platform/dts/bindings/solomon,ssd1363-spi.yaml
```yaml
description: SSD13363 320x160 OLED controller on SPI bus

compatible: "solomon,ssd1363-ext"

include: ["solomon,ssd1363-common-ext.yaml", "spi-device.yaml"]

properties:
  data-cmd-gpios:
    type: phandle-array
    required: true
    description: D/C# pin.
```

## platform/dts/bindings/st,stm32u5-adv-timer-ltd.yaml
```yaml
description: |
  ST STM32U5 Advanced Timer

  Limited implementation of an advanced timer driver that supports use with Waitara protection system.

compatible: "st,stm32u5-adv-timer-ltd"

include: [pinctrl-device.yaml, reset-device.yaml, base.yaml]

properties:
  reg:
    required: true

  pinctrl-0:
    required: true

  pinctrl-names:
    required: true

  interrupts:
    required: true
  
  resets:
    required: true

# Currently hard coding all other properties
```

## platform/dts/bindings/st,stm32u5-comp-ltd.yaml
```yaml
description: |
  ST STM32U5 Comparator

compatible: "st,stm32u5-comp-ltd"

include: [pinctrl-device.yaml, reset-device.yaml, base.yaml]

properties:
  reg:
    required: true

  pinctrl-0:
    required: true

  pinctrl-names:
    required: true

  interrupts:
    required: true
  
  resets:
    required: true

  input-plus:
    type: string
    enum:
      - "IO2"
      # Other options not implemented

  input-minus:
    type: string
    enum:
      - "VREFINT"
      - "VREFINT_1_2"
      - "VREFINT_3_4"
      # Other options not implemented

  output-polarity:
    type: string
    enum:
      - "NON_INVERTED"
      # Other options not implemented

  hysteresis:
    type: string
    enum:
      - "NONE"
      - "LOW"
      # Other options not implemented

  power-mode:
    type: string
    enum:
      - "HIGH_SPEED"
      # Other options not implemented

  interrupt-mode:
    type: string
    enum:
      - "RISING_EDGE"
      # Other options not implemented
```

## platform/dts/bindings/tesm62c1.yaml
```yaml
# TE SM62C1 gauge pressure sensor
# SPDX-License-Identifier: Apache-2.0 

description:
  TE SM62C1 gauge pressure sensor accessed through I2C bus

compatible: "tesm62c1"

include: [i2c-device.yaml]
```

## platform/src/modem-celluar/Kconfig
```kconfig
menuconfig MODEM_RC7620
	bool "FPH RC7620 modem support"
	depends on DT_HAS_FPH_RC7620_ENABLED
	depends on PM_DEVICE
	depends on NET_L2_PPP
	select MODEM_MODULES
	select MODEM_CHAT
	select MODEM_CMUX
	select MODEM_PPP
	select MODEM_BACKEND_UART
	select RING_BUFFER
	select NET_L2_PPP_OPTION_MRU
	select NET_L2_PPP_PAP
	select NET_L2_PPP_MGMT
	help
	  Enables the platform-local RC7620 driver and keeps modem-specific
	  bring-up logic out of the vendor Zephyr tree.

if MODEM_RC7620

config MODEM_RC7620_UART_BUFFER_SIZE
	int "UART RX/TX buffer size"
	default 512

config MODEM_RC7620_CHAT_BUFFER_SIZE
	int "Chat buffer size"
	default 128

config MODEM_RC7620_PPP_BUFFER_SIZE
	int "PPP frame buffer size"
	default 128

config MODEM_RC7620_POWER_ON_PULSE_MS
	int "Power-on pulse width in milliseconds"
	default 250

config MODEM_RC7620_POWER_OFF_PULSE_MS
	int "Power-off pulse width in milliseconds"
	default 1500

config MODEM_RC7620_RESET_PULSE_MS
	int "Reset pulse width in milliseconds"
	default 200

config MODEM_RC7620_STARTUP_TIME_MS
	int "Startup delay in milliseconds"
	default 15000

config MODEM_RC7620_SHUTDOWN_TIME_MS
	int "Shutdown delay in milliseconds"
	default 5000

config MODEM_RC7620_PERIODIC_SCRIPT_MS
	int "Periodic status script interval in milliseconds"
	default 2000

endif
```

## targets/boards/fph/control/Kconfig.control
```kconfig
# Copyright (c) 2017, NXP
# SPDX-License-Identifier: Apache-2.0

config BOARD_REVISION_A4
    bool "Control A4 Board"
    select SOC_SERIES_IMX_RT
    select SOC_PART_NUMBER_MIMXRT1052CVL5B
```

## targets/boards/fph/control/Kconfig.defconfig
```kconfig
# Copyright (c) 2017, NXP
# SPDX-License-Identifier: Apache-2.0
#
# Copyright (c) Fisher & Paykel Healthcare. All Rights Reserved.
# Derived from mimxrt1050_evk.dts from zephyrproject/zephyr.
# Change notice: Adapt for Waitara

if BOARD_REVISION_A4

config BOARD
    default "mimxrt1050_fph_control_a4" if BOARD_REVISION_A4

config FW_CONTROL
    bool "control firmware"
    default true
    help
    Hints that the Firmware is for control MCU

config EARLY_INIT
    bool "Enables early init"
    default true
    help
      Used as a guard to enable running of routines that should occur before default Zephyr initialisation.
      i.e. FlexRAM reconfiguration.

endif # BOARD_REVISION_A4
```

## targets/boards/fph/control/board.yml
```yaml
board:
  name: control
  vendor: fph
  revision:
    format: custom
    revisions:
      - name: a4
  socs:
    - name: mimxrt1052
```

## targets/boards/fph/control/control_defconfig
```kconfig
# Copyright (c) 2017, NXP
# SPDX-License-Identifier: Apache-2.0

CONFIG_FW_CONTROL=y
CONFIG_DEVICE_CONFIGURATION_DATA=n
CONFIG_INIT_SYS_PLL=y
CONFIG_ARM_MPU=y
CONFIG_HW_STACK_PROTECTION=y
CONFIG_PINCTRL=y
CONFIG_EARLY_INIT=y

# i.MX RT1050 Reference Manual - 14.5
# Table 14-5. System Clock Frequency Values 
# Configure DCDC REG3: VDD_SOC Target value to (1.15+0.025)V
CONFIG_DCDC_VALUE=0x0F
```
